## arch/arm/configs/meson6tv_defconfig
```kconfig
CONFIG_KERNEL_LZMA=y
CONFIG_SYSVIPC=y
CONFIG_NO_HZ=y
CONFIG_HIGH_RES_TIMERS=y
CONFIG_BSD_PROCESS_ACCT=y
CONFIG_IKCONFIG=y
CONFIG_IKCONFIG_PROC=y
CONFIG_BLK_DEV_INITRD=y
CONFIG_INITRAMFS_SOURCE="rootfs.cpio"
CONFIG_KALLSYMS_ALL=y
CONFIG_EMBEDDED=y
CONFIG_MODULES=y
CONFIG_MODULE_UNLOAD=y
CONFIG_ARCH_MESON6TV=y
CONFIG_MESON_SUSPEND=y
CONFIG_MESON_LEGACY_REGISTER_API=y
# CONFIG_CACHE_L2X0 is not set
CONFIG_ARM_ERRATA_751472=y
CONFIG_ARM_ERRATA_754322=y
CONFIG_ARM_ERRATA_764369=y
CONFIG_SMP=y
CONFIG_NR_CPUS=2
CONFIG_AEABI=y
CONFIG_HIGHMEM=y
# CONFIG_COMPACTION is not set
CONFIG_VFP=y
CONFIG_NEON=y
CONFIG_BINFMT_MISC=y
CONFIG_WAKELOCK=y
CONFIG_PACKET=y
CONFIG_PACKET_DIAG=y
CONFIG_UNIX=y
CONFIG_UNIX_DIAG=y
CONFIG_NET_KEY=y
CONFIG_INET=y
CONFIG_IP_ADVANCED_ROUTER=y
CONFIG_IP_MULTIPLE_TABLES=y
CONFIG_INET_ESP=y
CONFIG_IPV6=y
CONFIG_IPV6_PRIVACY=y
CONFIG_IPV6_ROUTER_PREF=y
CONFIG_IPV6_OPTIMISTIC_DAD=y
CONFIG_INET6_AH=y
CONFIG_INET6_ESP=y
CONFIG_INET6_IPCOMP=y
CONFIG_IPV6_MIP6=y
CONFIG_IPV6_TUNNEL=y
CONFIG_IPV6_MULTIPLE_TABLES=y
CONFIG_NETFILTER=y
CONFIG_NF_CONNTRACK=y
CONFIG_NF_CONNTRACK_EVENTS=y
CONFIG_NF_CT_PROTO_DCCP=y
CONFIG_NF_CT_PROTO_SCTP=y
CONFIG_NF_CT_PROTO_UDPLITE=y
CONFIG_NF_CONNTRACK_AMANDA=y
CONFIG_NF_CONNTRACK_FTP=y
CONFIG_NF_CONNTRACK_H323=y
CONFIG_NF_CONNTRACK_IRC=y
CONFIG_NF_CONNTRACK_NETBIOS_NS=y
CONFIG_NF_CONNTRACK_PPTP=y
CONFIG_NF_CONNTRACK_SANE=y
CONFIG_NF_CONNTRACK_TFTP=y
CONFIG_NF_CT_NETLINK=y
CONFIG_NETFILTER_TPROXY=y
CONFIG_NETFILTER_XT_TARGET_CLASSIFY=y
CONFIG_NETFILTER_XT_TARGET_CONNMARK=y
CONFIG_NETFILTER_XT_TARGET_MARK=y
CONFIG_NETFILTER_XT_TARGET_NFLOG=y
CONFIG_NETFILTER_XT_TARGET_NFQUEUE=y
CONFIG_NETFILTER_XT_TARGET_TPROXY=y
CONFIG_NETFILTER_XT_TARGET_TRACE=y
CONFIG_NETFILTER_XT_MATCH_COMMENT=y
CONFIG_NETFILTER_XT_MATCH_CONNBYTES=y
CONFIG_NETFILTER_XT_MATCH_CONNLIMIT=y
CONFIG_NETFILTER_XT_MATCH_CONNMARK=y
CONFIG_NETFILTER_XT_MATCH_CONNTRACK=y
CONFIG_NETFILTER_XT_MATCH_HASHLIMIT=y
CONFIG_NETFILTER_XT_MATCH_HELPER=y
CONFIG_NETFILTER_XT_MATCH_IPRANGE=y
CONFIG_NETFILTER_XT_MATCH_LENGTH=y
CONFIG_NETFILTER_XT_MATCH_LIMIT=y
CONFIG_NETFILTER_XT_MATCH_MAC=y
CONFIG_NETFILTER_XT_MATCH_MARK=y
CONFIG_NETFILTER_XT_MATCH_POLICY=y
CONFIG_NETFILTER_XT_MATCH_PKTTYPE=y
CONFIG_NETFILTER_XT_MATCH_QTAGUID=y
CONFIG_NETFILTER_XT_MATCH_QUOTA=y
CONFIG_NETFILTER_XT_MATCH_QUOTA2=y
CONFIG_NETFILTER_XT_MATCH_QUOTA2_LOG=y
CONFIG_NETFILTER_XT_MATCH_SOCKET=y
CONFIG_NETFILTER_XT_MATCH_STATE=y
CONFIG_NETFILTER_XT_MATCH_STATISTIC=y
CONFIG_NETFILTER_XT_MATCH_STRING=y
CONFIG_NETFILTER_XT_MATCH_TIME=y
CONFIG_NETFILTER_XT_MATCH_U32=y
CONFIG_NF_CONNTRACK_IPV4=y
CONFIG_IP_NF_IPTABLES=y
CONFIG_IP_NF_MATCH_AH=y
CONFIG_IP_NF_MATCH_ECN=y
CONFIG_IP_NF_MATCH_TTL=y
CONFIG_IP_NF_FILTER=y
CONFIG_IP_NF_TARGET_REJECT=y
CONFIG_IP_NF_TARGET_REJECT_SKERR=y
CONFIG_NF_NAT_IPV4=y
CONFIG_IP_NF_TARGET_MASQUERADE=y
CONFIG_IP_NF_TARGET_NETMAP=y
CONFIG_IP_NF_TARGET_REDIRECT=y
CONFIG_IP_NF_MANGLE=y
CONFIG_IP_NF_RAW=y
CONFIG_IP_NF_ARPTABLES=y
CONFIG_IP_NF_ARPFILTER=y
CONFIG_IP_NF_ARP_MANGLE=y
CONFIG_NF_CONNTRACK_IPV6=y
CONFIG_IP6_NF_IPTABLES=y
CONFIG_IP6_NF_FILTER=y
CONFIG_IP6_NF_TARGET_REJECT=y
CONFIG_IP6_NF_TARGET_REJECT_SKERR=y
CONFIG_IP6_NF_MANGLE=y
CONFIG_IP6_NF_RAW=y
CONFIG_NF_NAT_IPV6=y
CONFIG_IP6_NF_TARGET_MASQUERADE=y
CONFIG_IP6_NF_TARGET_NPT=y
CONFIG_BRIDGE=y
# CONFIG_BRIDGE_IGMP_SNOOPING is not set
CONFIG_PHONET=y
CONFIG_NET_SCHED=y
CONFIG_NET_SCH_HTB=y
CONFIG_NET_SCH_INGRESS=y
CONFIG_NET_CLS_U32=y
CONFIG_NET_EMATCH=y
CONFIG_NET_EMATCH_U32=y
CONFIG_NET_CLS_ACT=y
CONFIG_NET_ACT_POLICE=y
CONFIG_NET_ACT_GACT=y
CONFIG_NET_ACT_MIRRED=y
# CONFIG_OF_LM is not set
# CONFIG_AML_RTC is not set
CONFIG_AM_REMOTE=y
# CONFIG_MESON_NEW_INPUT_REMOTE is not set
# CONFIG_MESON_INPUT_KEYBOARD is not set
# CONFIG_AMLOGIC_BOARD_HAS_PMU is not set
# CONFIG_AMAUDIO is not set
# CONFIG_AM_CANVAS is not set
# CONFIG_AM_DISPLAY_MODULE is not set
# CONFIG_AML_HDMI_TX is not set
# CONFIG_MALI400 is not set
# CONFIG_AMLOGIC_ION is not set
# CONFIG_CRYPTO_AML_HW_CRYPRO is not set
# CONFIG_CRYPTO_DEVICE_DRIVER is not set
CONFIG_AM_VECM=y
CONFIG_UEVENT_HELPER_PATH="/sbin/hotplug"
CONFIG_DEVTMPFS=y
CONFIG_DEVTMPFS_MOUNT=y
CONFIG_PROC_DEVICETREE=y
CONFIG_OF_SELFTEST=y
CONFIG_BLK_DEV_LOOP=y
CONFIG_SCSI=y
CONFIG_BLK_DEV_SD=y
CONFIG_BLK_DEV_SR=y
CONFIG_SCSI_MULTI_LUN=y
CONFIG_INPUT_POLLDEV=y
CONFIG_INPUT_EVDEV=y
CONFIG_INPUT_MISC=y
CONFIG_INPUT_UINPUT=y
CONFIG_DEVPTS_MULTIPLE_INSTANCES=y
CONFIG_I2C=y
CONFIG_I2C_CHARDEV=y
CONFIG_SOUND=y
CONFIG_SND=y
CONFIG_SND_SOC=y
CONFIG_SND_AML_M6_SOC=y
CONFIG_SND_AML_M_DUMMY_CODEC=y
# CONFIG_HID_GENERIC is not set
# CONFIG_USB_SUPPORT is not set
CONFIG_SWITCH=y
CONFIG_RTC_CLASS=y
CONFIG_UIO=y
CONFIG_UIO_PDRV=y
CONFIG_UIO_PDRV_GENIRQ=y
CONFIG_STAGING=y
CONFIG_ANDROID=y
CONFIG_ANDROID_BINDER_IPC=y
CONFIG_ASHMEM=y
CONFIG_ANDROID_LOGGER=y
CONFIG_ANDROID_LOW_MEMORY_KILLER=y
CONFIG_EXT2_FS=y
CONFIG_EXT3_FS=y
CONFIG_EXT3_FS_POSIX_ACL=y
CONFIG_EXT3_FS_SECURITY=y
CONFIG_EXT4_FS=y
CONFIG_EXT4_FS_POSIX_ACL=y
CONFIG_EXT4_FS_SECURITY=y
CONFIG_EXT4_DEBUG=y
CONFIG_QUOTA=y
CONFIG_QFMT_V2=y
CONFIG_FUSE_FS=y
CONFIG_ISO9660_FS=y
CONFIG_JOLIET=y
CONFIG_ZISOFS=y
CONFIG_UDF_FS=y
CONFIG_MSDOS_FS=y
CONFIG_VFAT_FS=y
CONFIG_TMPFS=y
CONFIG_CONFIGFS_FS=y
CONFIG_CRAMFS=y
CONFIG_NLS_CODEPAGE_437=y
CONFIG_NLS_ISO8859_1=y
CONFIG_PRINTK_TIME=y
CONFIG_MAGIC_SYSRQ=y
CONFIG_READABLE_ASM=y
CONFIG_DEBUG_FS=y
CONFIG_DEBUG_SECTION_MISMATCH=y
CONFIG_SCHEDSTATS=y
CONFIG_TIMER_STATS=y
CONFIG_DEBUG_INFO=y
CONFIG_RCU_CPU_STALL_TIMEOUT=60
# CONFIG_FTRACE is not set
CONFIG_CRC_T10DIF=y
CONFIG_CRC7=y
```

## arch/arm/mach-meson/Kconfig
```kconfig
menu "Meson platform type"
	depends on ARCH_MESON

config MACH_MESON_6236M
	bool "Support M1 6236(MODE:MBOX728) platform(machid=2951)"
	help
	  Include support for the AMLOGIC M1 6236M Emulation Baseboard platform.

config MACH_MESON_8626M
	bool "Support M1 8626(MBOX_8626M1_V1.0) platform(machid=2952)"
	help
	  Include support for the AMLOGIC M1 8626M Emulation Baseboard platform.

config MACH_MESON_6236M_SH
	bool "Support M1 6236(dpf_aml6236-m_innolux8_skt_v1) platform(machid=2953)"
	help
	  Include support for the AMLOGIC M1 6236M Emulation Baseboard platform.

config MACH_MESON_8626M_SH
	bool "Support M1 8626(mbx_aml8626-m_skt_v1) platform(machid=2954)"
	help
	  Include support for the AMLOGIC M1 8626M Emulation Baseboard platform.

config MACH_MESON_8226M
	bool "Support M1 8226(dvbc_8226m1_v1.0) platform(machid=2955)"
	help
	  Include support for the AMLOGIC M1 8226M Emulation Baseboard platform.

config MESON_CLOCK_TICK_RATE
    int "Clock Tick Rate"
	default 25000000

endmenu
```

## drivers/amlogic/cardreader/Kconfig
```kconfig
#
# cardreader subsystem configuration
#

menu "Amlogic Card support"

config CARDREADER
	bool "Card reader support "
	default n

config SD_MMC
	bool "SD/MMC card driver support"
	default y
	depends on CARDREADER

config AM_ATA
	bool "ATA/ATAPI driver support"
	default n
	depends on CARDREADER

config CF
	bool "CF card driver support"
	default n
	depends on AM_ATA

config MS_MSPRO
	bool "MS/MSPRO card driver support"
	default n
	depends on CARDREADER

config XD
	bool "XD card driver support"
	default n
	depends on CARDREADER

endmenu
```

## drivers/amlogic/cpufreq/Kconfig
```kconfig
config AMLOGIC_MESON_CPUFREQ
	bool "Meson CPU Frequency scaling support"
	depends on PLAT_MESON
	help
	  This adds the CPUFreq driver for Meson series CPU

config ARM_MESON_CPUFREQ
	bool "[obsoleted] Meson6 CPU Frequency scaling support"
	depends on ARCH_MESON6
	help
	   This adds the CPUFreq driver for Meson CPU.
	   This driver is not clean, it's obsolete.
```

## drivers/amlogic/demod/Kconfig
```kconfig
menu "AMLOGIC DEMOD Support"

config AM_DEMOD
	bool "Amlogic Demod Support"
	default y
	help
		m1 internal Demod DVB-T/C suport
endmenu
```

## drivers/amlogic/display/vout/lcd_extern/Kconfig
```kconfig
#
# Video output configuration
#
menu "Amlogic LCD External driver"

config AML_LCD_EXTERN
	tristate "LCD External driver"
	default y
	help  
		lcd exteranl driver

endmenu
```

## drivers/amlogic/dvb_tv/atbm887x/Kconfig
```kconfig
#
# Atbm887x driver configuration
#
menuconfig AM_ATBM8869
	tristate "ATBM8869 demod driver"
	default n
	depends on AM_DVB
	help
		Select to enable AM_ATBM8878 demod driver.

if AM_ATBM8869

config ATBM8869_TS_PARALLEL_MODE
	bool "ATBM8869_TS_PARALLEL_MODE"
	depends on AM_ATBM8869
	default n
	help
	 select ATBM8869_TS_PARALLEL_MODE,default is ATBM8869_TS_SERIAL_MODE

endif
```

## drivers/amlogic/hdmi/Kconfig
```kconfig
menu "HDMI TX Support"

config AML_HDMI_TX
        bool "HDMI Output Enable"
        default y
        select SWITCH
        select AM_DISPLAY_MODULE
        help  
                hdmi output enable,It should be enalbe if board have hdmi out interface

if AML_HDMI_TX
config AML_HDMI_TX_HDCP
        bool "HDMI HDCP Enable"
        default n
        help
                hdmitx hdcp enable, it should be enalbe if board burned hdmitx hdcp keys
endif

endmenu
```

## drivers/amlogic/power/aml_pmu/Kconfig
```kconfig
menuconfig AML_PMU
    bool    "Amlogic PMU drivers"
    depends on AMLOGIC_BOARD_HAS_PMU
    select  I2C
    select  REGULATOR
    default n
    ---help---
        say yes if you want add Amlogic power management unit support
if AML_PMU
choice 
    prompt "AML PMU type"
    default AML1212

config AML1212
    bool "AML1212 driver"
    ---help---
        drivers for AML1212

config AML1216
    bool "AML1216 driver"
    ---help---
        drivers for amlogic pmu AML1216 

endchoice

endif #AML_PMU
```

## drivers/amlogic/thermal/Kconfig
```kconfig
# Amlogic Thermal


config AMLOGIC_THERMAL
    bool "amlogic thermal support"
    select THERMAL
    select CPU_THERMAL
    default n
    help
      This is the Amlogic Thermal interface driver
```

## drivers/amlogic/uart/Kconfig
```kconfig
menu "Amlogic UART Support"

config AM_UART
        bool "Amlogic Uart support"
        default y
        depends on ARCH_MESON
        select SERIAL_CORE
        select SERIAL_CORE_CONSOLE
        help
           hardware uart

endmenu
```

## sound/soc/aml/m6/Kconfig
```kconfig
config SND_AML_M6_RT5631
	tristate "M6 evaluation board with RT5631"
	depends on SND_AML_M6_SOC
	select SND_SOC_RT5631 if SND_AML_M6_RT5631

config SND_AML_M6_RT5616
	tristate "M6 evaluation board with RT5616"
	depends on SND_AML_M6_SOC
	select SND_SOC_RT5616 if SND_AML_M6_RT5616

config SND_AML_M6_RT3261
	tristate "M6 evaluation board with RT3261"
	depends on SND_AML_M6_SOC
	select SND_SOC_RT3261 if SND_AML_M6_RT3261
	select SND_HWDEP
config SND_AML_M6_WM8960
	tristate "M6 evaluation board with WM8960"
	depends on SND_AML_M6_SOC
	select SND_SOC_WM8960 if SND_AML_M6_WM8960
config SND_AML_M6_PCM2BT
	tristate "M6 evaluation board with PCM2BT"
	depends on SND_AML_M6_SOC
	select SND_SOC_PCM2BT

config SND_AML_M_DUMMY_CODEC
    tristate "AML M series board with DUMMY_CODEC"
    depends on SND_AML_M6_SOC
    select SND_SOC_DUMMY_CODEC if SND_AML_M_DUMMY_CODEC
config SND_AML_M6TV_AUDIO_CODEC
	tristate "AML M6TV evaluation board,this must be selected for all m6tv board"
	depends on SND_AML_M6_SOC
config SND_AML_M6TV_SYNOPSYS9629_CODEC
	tristate "AML M6TV  board with internal syno9629 codec"
	depends on SND_AML_M6TV_AUDIO_CODEC
config SND_AML_M6TV_STA380
	tristate "AML M6TV board with STA380 codec"
	depends on SND_AML_M6TV_AUDIO_CODEC
	select SND_SOC_STA380 if SND_AML_M6TV_STA380
config SND_AML_M6TV_TAS5711
	tristate "AML M6TV board with TAS5711 codec"
	depends on SND_AML_M6TV_AUDIO_CODEC
	select SND_SOC_TAS5711 if SND_AML_M6TV_TAS5711
if SND_AML_M6TV_TAS5711
choice
	prompt "TAS5711 work mode"
	default TAS5711_2_CHANNEL
config TAS5711_2_CHANNEL
	bool "2 BTL channel mode"
config TAS5711_2_PLUS_1_CHANNEL
	bool "2.1 channel mode"
config TAS5711_2_SUBWOOFER_CHANNEL
	bool "2 BTL subwoofer channel"
endchoice
endif
config SND_AML_M6TV_TAS5707
	tristate "AML M6TV board with TAS5707 codec"
	depends on SND_AML_M6TV_AUDIO_CODEC
	select SND_SOC_TAS5707 if SND_AML_M6TV_TAS5707
if SND_AML_M6TV_TAS5707
choice
	prompt "TAS5707 work mode"
	default TAS5707_2_CHANNEL
config TAS5707_2_CHANNEL
	bool "2 BTL channel mode"
config TAS5707_2_SUBWOOFER_CHANNEL
	bool "2 BTL subwoofer channel"
endchoice
endif
```

## sound/soc/aml/m8/Kconfig
```kconfig
#config  SND_AML_SPDIF
#	tristate "Amlogic S/PDIF codec support"
#	depends on SND_AML_M8_SOC
#	select SND_SOC_AML_SPDIF_CODEC if SND_AML_SPDIF
config SND_AML_M8
	tristate "AML-SND-M8 Board"
	depends on SND_AML_M8_SOC && SWITCH
	select SND_SOC_AML_M8_CODEC if SND_AML_M8
	select SND_SOC_RT5616 if SND_AML_M8
	select SND_SOC_WM8960
	select SND_SOC_RT5631
	
config SND_AML_M8_PCM
	tristate "M8 evaluation board with PCM2BT"
	depends on SND_AML_M8_SOC
	select SND_SOC_PCM2BT if SND_AML_M8_PCM
	
```
